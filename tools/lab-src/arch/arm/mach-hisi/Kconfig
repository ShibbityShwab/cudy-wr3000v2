## tools/lab-src/arch/arm/mach-hisi/Kconfig
```kconfig
# SPDX-License-Identifier: GPL-2.0-only
config ARCH_HISI
	bool "Hisilicon SoC Support"
	depends on ARCH_MULTI_V7 || ARCH_MULTI_V5
	select ARM_AMBA
	select ARM_GIC if ARCH_MULTI_V7
	select ARM_TIMER_SP804
	select POWER_RESET
	select POWER_RESET_HISI
	select POWER_SUPPLY

if ARCH_HISI

menu "Hisilicon platform type"

config ARCH_HI3xxx
	bool "Hisilicon Hi36xx family"
	depends on ARCH_MULTI_V7
	select CACHE_L2X0
	select HAVE_ARM_SCU if SMP
	select HAVE_ARM_TWD if SMP
	select PINCTRL
	select PINCTRL_SINGLE
	help
	  Support for Hisilicon Hi36xx SoC family

config ARCH_HIP01
	bool "Hisilicon HIP01 family"
	depends on ARCH_MULTI_V7
	select HAVE_ARM_SCU if SMP
	select HAVE_ARM_TWD if SMP
	select ARM_GLOBAL_TIMER
	help
	  Support for Hisilicon HIP01 SoC family

config ARCH_HIP04
	bool "Hisilicon HiP04 Cortex A15 family"
	depends on ARCH_MULTI_V7
	select ARM_ERRATA_798181 if SMP
	select HAVE_ARM_ARCH_TIMER
	select MCPM if SMP
	select MCPM_QUAD_CLUSTER if SMP
	select GENERIC_IRQ_EFFECTIVE_AFF_MASK
	help
	  Support for Hisilicon HiP04 SoC family

config ARCH_HIX5HD2
	bool "Hisilicon X5HD2 family"
	depends on ARCH_MULTI_V7
	select CACHE_L2X0
	select HAVE_ARM_SCU if SMP
	select HAVE_ARM_TWD if SMP
	select PINCTRL
	select PINCTRL_SINGLE
	help
	  Support for Hisilicon HIX5HD2 SoC family

config ARCH_LUOFU
	bool "Hisilicon luofu (Hi5671Y) family"
	depends on ARCH_MULTI_V7
	select CACHE_L2X0
	select HAVE_ARM_SCU if SMP
	select HAVE_ARM_TWD if SMP
	help
	  Support for the Hisilicon Hi5671Y "luofu" SoC (board R116, the Cudy
	  WR3000 v2.0). The machine code is arch/arm/mach-luofu/luofu.c: it only
	  matches the luofu devicetree and programs no hardware itself, so what
	  comes up is exactly what the DT plus the drivers binding to it can do.
	  A UP boot is the expected first posture - the DT enable-method is the
	  vendor's "hisilicon,hsan_smp", which has no mainline smp_ops yet.

config ARCH_SD5203
	bool "Hisilicon SD5203 family"
	depends on ARCH_MULTI_V5
	select DW_APB_ICTL
	help
	  Support for Hisilicon SD5203 SoC family

endmenu

endif
```

## tools/lab-src/drivers/net/ethernet/luofu/Kconfig
```kconfig
# SPDX-License-Identifier: GPL-2.0
#
# HiSilicon luofu (Hi5671Y) network controllers
#

config LUOFU_GMAC
	tristate "HiSilicon luofu GMAC ethernet controller"
	depends on OF
	depends on PHYLINK
	help
	  Ethernet MAC driver for the HiSilicon luofu SoC family (Cudy WR3000
	  v2). Five MAC instances share one MDIO bus; the driver is a phylink
	  port like the vendor's hi_kmac.ko.

config LUOFU_MDIO
	tristate "HiSilicon luofu MDIO bus controller"
	depends on OF
	help
	  MDIO bus driver for the HiSilicon luofu SoC family. The vendor's
	  module is hi_kmdio.ko; the register map in the driver came from its
	  own hi_mdio_read/hi_mdio_write.
```
